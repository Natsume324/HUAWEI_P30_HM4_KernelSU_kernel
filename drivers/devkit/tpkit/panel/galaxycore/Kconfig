## drivers/devkit/tpkit/panel/galaxycore/Kconfig
```kconfig
#
# huawei touchscreen driver configuration
#

menuconfig GALAXYCORE_TS_KIT
	bool "huawei  ts kit galaxycore drivers"
	default n
	help
	  If you say yes here you get support for huawei touchscreen.
```
